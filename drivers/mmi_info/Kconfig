## drivers/mmi_info/Kconfig
```kconfig
config MMI_INFO
	tristate "Motorola MMI info"
	depends on QCOM_SMEM
	help
	  Exposes the Motorola boot, unit, RAM and storage information
	  passed by the bootloader (/proc/bootinfo, /sys/ram, /sys/storage,
	  ...) and provides the unit info the modem reads from SMEM.

	  This driver can also be built as a module. If so, the module
	  will be called mmi_info.
```
